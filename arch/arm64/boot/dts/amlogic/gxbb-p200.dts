/*
 * Amlogic Ltd. GXBaby Plaform
 */

/dts-v1/;
#include <dt-bindings/clock/amlogic,gxbb.h>
#include "mesongxbb.dtsi"
/ {
	model = "Amlogic";
	compatible = "amlogic, Gxbb";
	interrupt-parent = <&gic>;
	#address-cells = <2>;
	#size-cells = <2>;

	aliases {
		serial0 = &uart_AO;
	};

	memory@00000000 {
		device_type = "memory";
		linux,usable-memory = <0x0 0x1000000 0x0 0x3f000000>;
	};


	uart_AO: serial@c81004c0 {
		compatible = "amlogic, meson-uart";
		reg = <0x0 0xc81004c0 0x0 0x14>;
		interrupts = <0 193 1>;
		status = "okay";
		clocks = <&clock CLK_XTAL>;
		clock-names = "clk_uart";
		fifosize = < 64 >;
		pinctrl-names = "default";
		//pinctrl-0 = <&ao_uart_pins>;
	};
};
